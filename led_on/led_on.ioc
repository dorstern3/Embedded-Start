# file: led_on.ioc
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Mcu.Family=STM32F3
Mcu.Name=STM32F303K(6-8)Tx
Mcu.Package=LQFP32
NVIC.PriorityGroup=NVIC_PRIORITYGROUP_4
PB3.GPIO_Label=LED3
PB3.Signal=GPIO_Output
ProjectManager.HeapSize=0x200
ProjectManager.StackSize=0x400
ProjectManager.TargetToolchain=STM32CubeIDE
RCC.AHBFreq_Value=8000000
RCC.APB1Freq_Value=8000000
RCC.APB2Freq_Value=8000000
RCC.CortexFreq_Value=8000000
RCC.HSE_VALUE=8000000
RCC.HSI_VALUE=8000000
RCC.SYSCLKFreq_VALUE=8000000
board=custom

// file: Core/Src/main.c
/* USER CODE BEGIN Header */
/**
  ******************************************************************************
  * @file           : main.c
  * @brief          : Main program body
  ******************************************************************************
  * @attention
  *
  * Copyright (c) 2022 STMicroelectronics.
  * All rights reserved.
  *
  * This software is licensed under terms that can be found in the LICENSE file
  * in the root directory of this software component.
  * If no LICENSE file comes with this software, it is provided AS-IS.
  *
  ******************************************************************************
  */
/* USER CODE END Header */
#include "main.h"

void SystemClock_Config(void);
static void MX_GPIO_Init(void);

int main(void)
{

  /* MCU Configuration--------------------------------------------------------*/

  /* Reset of all peripherals, Initializes the Flash interface and the Systick. */
  HAL_Init();

  /* Configure the system clock */
  SystemClock_Config();

  /* Initialize all configured peripherals */

//  HAL_GPIO_TogglePin Function
  //MX_GPIO_Init();

  /* Infinite loop */
  /* USER CODE BEGIN WHILE */
  while (1)
  {

// OPTION 1 - HAL_GPIO_TogglePin
//	 Port b , Pin 3
//	 HAL_GPIO_TogglePin(GPIOB, GPIO_PIN_3);

// OPTION 2 - HAL_GPIO_TogglePin
//	  Name: LED3 , Pin LED3
//	 HAL_GPIO_TogglePin(LED3_GPIO_Port, LED3_Pin);
//	 HAL_Delay(1000);

// OPTION 3 - ORIGNAL COURSE
//	  1. Enable clock
	  uint32_t *pEnableClock   = (uint32_t*)0x40021014;
//	  2. Address GPIOB  mode register
	  uint32_t *pModeBRegister = (uint32_t*)0x48000400;
//	  3. Address GPIOB output
	  uint32_t *pOutPut  = (uint32_t*)0x48000414;
//	 4. Enable clock GPIOB
	  *pEnableClock |= 0X00040000;
//	 5. configure the mode of the IO pin as output
//    Clear the MODER3 bit positions (CLEAR)
	  *pModeBRegister &= 0xFFFFFF3F;
//	 6. Set  MODER3 , port B
	  *pModeBRegister  |= 0x00000040;
//	 7. SET 3th bits of the output data register to make I/O pin-12 as HIGH
	  *pOutPut |= 0x8;

//// OPTION 4 - Bit Wise
////	  1. Enable clock
//	  	  uint32_t *pEnableClock   = (uint32_t*)0x40021014;
////	  2. Address GPIOB  mode register
//	  	  uint32_t *pModeBRegister = (uint32_t*)0x48000400;
////	  3. Address GPIOB output
//	  	  uint32_t *pOutPut  = (uint32_t*)0x48000414;
////	 4. Enable clock GPIOB
////	    Set the 18 bit position
//	  	  *pEnableClock |= (1 << 18);
////	 5. configure the mode of the IO pin as output
////         Clear the 6 and 7 bit positions (CLEAR)
//	  	  *pModeBRegister &= ~( 3 << 6);
////	 6. Set bit 6 , port B
//	  	  *pModeBRegister  |= (1 << 6 );
////	 7. SET 3th bits of the output data register to make I/O pin-12 as HIGH
//	  	  *pOutPut |= (1 << 3);

    /* USER CODE END WHILE */

  }
}

void SystemClock_Config(void)
{
  RCC_OscInitTypeDef RCC_OscInitStruct = {0};
  RCC_ClkInitTypeDef RCC_ClkInitStruct = {0};

  /** Initializes the RCC Oscillators according to the specified parameters
  * in the RCC_OscInitTypeDef structure.
  */
  RCC_OscInitStruct.OscillatorType = RCC_OSCILLATORTYPE_HSI;
  RCC_OscInitStruct.HSIState = RCC_HSI_ON;
  RCC_OscInitStruct.HSICalibrationValue = RCC_HSICALIBRATION_DEFAULT;
  RCC_OscInitStruct.PLL.PLLState = RCC_PLL_NONE;
  if (HAL_RCC_OscConfig(&RCC_OscInitStruct) != HAL_OK)
  {
    Error_Handler();
  }

  /** Initializes the CPU, AHB and APB buses clocks
  */
  RCC_ClkInitStruct.ClockType = RCC_CLOCKTYPE_HCLK|RCC_CLOCKTYPE_SYSCLK
                              |RCC_CLOCKTYPE_PCLK1|RCC_CLOCKTYPE_PCLK2;
  RCC_ClkInitStruct.SYSCLKSource = RCC_SYSCLKSOURCE_HSI;
  RCC_ClkInitStruct.AHBCLKDivider = RCC_SYSCLK_DIV1;
  RCC_ClkInitStruct.APB1CLKDivider = RCC_HCLK_DIV1;
  RCC_ClkInitStruct.APB2CLKDivider = RCC_HCLK_DIV1;

  if (HAL_RCC_ClockConfig(&RCC_ClkInitStruct, FLASH_LATENCY_0) != HAL_OK)
  {
    Error_Handler();
  }
}

static void MX_GPIO_Init(void)
{
  GPIO_InitTypeDef GPIO_InitStruct = {0};

  /* GPIO Ports Clock Enable */
  __HAL_RCC_GPIOB_CLK_ENABLE();

  /*Configure GPIO pin Output Level */
  HAL_GPIO_WritePin(LED3_GPIO_Port, LED3_Pin, GPIO_PIN_RESET);

  /*Configure GPIO pin : LED3_Pin */
  GPIO_InitStruct.Pin = LED3_Pin;
  GPIO_InitStruct.Mode = GPIO_MODE_OUTPUT_PP;
  GPIO_InitStruct.Pull = GPIO_NOPULL;
  GPIO_InitStruct.Speed = GPIO_SPEED_FREQ_LOW;
  HAL_GPIO_Init(LED3_GPIO_Port, &GPIO_InitStruct);

}

void Error_Handler(void)
{
  __disable_irq();
  while (1)
  {
  }
}
