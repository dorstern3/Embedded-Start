# file: PinRead.ioc
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Mcu.Family=STM32F3
Mcu.Name=STM32F303K(6-8)Tx
Mcu.Package=LQFP32
NVIC.PriorityGroup=NVIC_PRIORITYGROUP_4
ProjectManager.HeapSize=0x200
ProjectManager.StackSize=0x400
ProjectManager.TargetToolchain=STM32CubeIDE
RCC.AHBFreq_Value=8000000
RCC.APB1Freq_Value=8000000
RCC.APB2Freq_Value=8000000
RCC.CortexFreq_Value=8000000
RCC.HSE_VALUE=8000000
RCC.HSI_VALUE=8000000
RCC.SYSCLKFreq_VALUE=8000000
board=custom

// file: Core/Src/main.c
/* USER CODE BEGIN Header */
/**
  ******************************************************************************
  * @file           : main.c
  * @brief          : Main program body
  ******************************************************************************
  * @attention
  *
  * Copyright (c) 2022 STMicroelectronics.
  * All rights reserved.
  *
  * This software is licensed under terms that can be found in the LICENSE file
  * in the root directory of this software component.
  * If no LICENSE file comes with this software, it is provided AS-IS.
  *
  ******************************************************************************
  */
/* USER CODE END Header */
#include "main.h"

void SystemClock_Config(void);

int main(void)
{

  /* MCU Configuration--------------------------------------------------------*/

  /* Reset of all peripherals, Initializes the Flash interface and the Systick. */
  HAL_Init();

  /* Configure the system clock */
  SystemClock_Config();

  /* Initialize all configured peripherals */

  /* Infinite loop */
  /* USER CODE BEGIN WHILE */
  while (1)
  {

//	1. Enable clock
	  	  	 uint32_t *pEnableClock   = (uint32_t*)0x40021014;
//	2. Address GPIOB  mode register
	  	  	 uint32_t *pModeBRegister = (uint32_t*)0x48000400;
//	3. Address GPIOB output
	  	  	 uint32_t *pOutPut  = (uint32_t*)0x48000414;

//	4. Address GPIOA  mode register
	  	  	 uint32_t *pModeARegister = (uint32_t*)0x48000000;
//	5. Address in GPIOA register (Input = Read the pin status)
//	  	  	 0x48000000 + 0x10(input) Address offset
	  	  	uint32_t *pModeAInReg = (uint32_t*)0x48000010;

//	6. Enable clock for GPOIB , GPOIA in the AHBENR

//	    Set the 18 bit position GPOIB
	  	  	 *pEnableClock |= (1 << 18);
//	    Set the 1 bit position GPOIA
	  	  	 *pEnableClock |= (1 << 17);

//  7a. configure the mode of the IO pin as output
//	  	  Clear the 6 and 7 bit positions (CLEAR)
	  	  	 *pModeBRegister &= ~( 3 << 6);
//	7b. Set bit 6 , port B
	  	  	 *pModeBRegister  |= (1 << 6 );

//	8. Configure PA0 as input mode (GPIOA register mode)
	  	  	 *pModeARegister &= ~(3 << 0);

	  while(1)
	  {
//	 9. Read the pin status of the pin PA0 (GPIOA input data register)
//	  	  	Zero out all other bits except bit 0
	  	  	uint8_t PinStatus = (uint8_t)(*pModeAInReg & 0x1);

	  	  	if(PinStatus){
//	 Turn on the LED
//	 SET 3th bits of the output data register to make I/O pin-12 as HIGH
	  	  	*pOutPut |= (1 << 3);
	  	  	}
	  	  	else{
//	  Turn off the LED
	  	  	*pOutPut &= ~(1 << 3);
//	  	    *pOutPut  &=0X0;
	  	  	}
	  }

    /* USER CODE END WHILE */

  }
}

void SystemClock_Config(void)
{
  RCC_OscInitTypeDef RCC_OscInitStruct = {0};
  RCC_ClkInitTypeDef RCC_ClkInitStruct = {0};

  /** Initializes the RCC Oscillators according to the specified parameters
  * in the RCC_OscInitTypeDef structure.
  */
  RCC_OscInitStruct.OscillatorType = RCC_OSCILLATORTYPE_HSI;
  RCC_OscInitStruct.HSIState = RCC_HSI_ON;
  RCC_OscInitStruct.HSICalibrationValue = RCC_HSICALIBRATION_DEFAULT;
  RCC_OscInitStruct.PLL.PLLState = RCC_PLL_NONE;
  if (HAL_RCC_OscConfig(&RCC_OscInitStruct) != HAL_OK)
  {
    Error_Handler();
  }

  /** Initializes the CPU, AHB and APB buses clocks
  */
  RCC_ClkInitStruct.ClockType = RCC_CLOCKTYPE_HCLK|RCC_CLOCKTYPE_SYSCLK
                              |RCC_CLOCKTYPE_PCLK1|RCC_CLOCKTYPE_PCLK2;
  RCC_ClkInitStruct.SYSCLKSource = RCC_SYSCLKSOURCE_HSI;
  RCC_ClkInitStruct.AHBCLKDivider = RCC_SYSCLK_DIV1;
  RCC_ClkInitStruct.APB1CLKDivider = RCC_HCLK_DIV1;
  RCC_ClkInitStruct.APB2CLKDivider = RCC_HCLK_DIV1;

  if (HAL_RCC_ClockConfig(&RCC_ClkInitStruct, FLASH_LATENCY_0) != HAL_OK)
  {
    Error_Handler();
  }
}

void Error_Handler(void)
{
  __disable_irq();
  while (1)
  {
  }
}
